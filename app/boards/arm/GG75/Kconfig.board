## app/boards/arm/GG75/Kconfig.board
```kconfig
# Copyright (c) 2020 Stefan Sundin (4pplet)
# SPDX-License-Identifier: MIT


config BOARD_GG75
	bool "GG75"
	depends on SOC_NRF52840_QIAA
```

## app/boards/arm/Lele69/Kconfig.board
```kconfig
# Copyright (c) 2020 Stefan Sundin (4pplet)
# SPDX-License-Identifier: MIT


config BOARD_Lele69
	bool "Lele69"
	depends on SOC_NRF52840_QIAA
```

## app/boards/shields/srh/Kconfig.shield
```kconfig
# Copyright (c) 2020 The ZMK Contributors
# SPDX-License-Identifier: MIT

config SHIELD_SRH
    def_bool $(shields_list_contains,srh)
```
