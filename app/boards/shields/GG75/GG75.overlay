#include "GG75.dtsi"

/ {
	chosen {
		zmk,kscan = &kscan0;
	};

  kscan0: kscan_0 {
      compatible = "zmk,kscan-gpio-matrix";
      label = "KSCAN";


      diode-direction = "col2row";

      row-gpios
            = <&gpio1 4 (GPIO_ACTIVE_HIGH | GPIO_PULL_DOWN)>
              , <&gpio1 9 (GPIO_ACTIVE_HIGH | GPIO_PULL_DOWN)>
              , <&gpio0 5 (GPIO_ACTIVE_HIGH | GPIO_PULL_DOWN)>
              , <&gpio0 24 (GPIO_ACTIVE_HIGH | GPIO_PULL_DOWN)>
              , <&gpio0 9 (GPIO_ACTIVE_HIGH | GPIO_PULL_DOWN)>
              , <&gpio1 0 (GPIO_ACTIVE_HIGH | GPIO_PULL_DOWN)>
              , <&gpio0 12 (GPIO_ACTIVE_HIGH | GPIO_PULL_DOWN)>
              , <&gpio0 29 (GPIO_ACTIVE_HIGH | GPIO_PULL_DOWN)>
              , <&gpio0 30 (GPIO_ACTIVE_HIGH | GPIO_PULL_DOWN)>
              , <&gpio0 31 (GPIO_ACTIVE_HIGH | GPIO_PULL_DOWN)>
              ;
	};

};

&right_encoder {
    status = "okay";
};
